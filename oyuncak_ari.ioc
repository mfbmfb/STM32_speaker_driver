# file: oyuncak_ari.ioc
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Mcu.Family=STM32F1
Mcu.Name=STM32F103C(8-B)Tx
Mcu.Package=LQFP48
NVIC.PriorityGroup=NVIC_PRIORITYGROUP_4
PA8.Signal=S_TIM1_CH1
PD0-OSC_IN.Mode=HSE-External-Oscillator
PD0-OSC_IN.Signal=RCC_OSC_IN
PD1-OSC_OUT.Mode=HSE-External-Oscillator
PD1-OSC_OUT.Signal=RCC_OSC_OUT
ProjectManager.HeapSize=0x200
ProjectManager.StackSize=0x400
ProjectManager.TargetToolchain=STM32CubeIDE
RCC.AHBFreq_Value=72000000
RCC.APB1CLKDivider=RCC_HCLK_DIV2
RCC.APB1Freq_Value=36000000
RCC.APB1TimFreq_Value=72000000
RCC.APB2Freq_Value=72000000
RCC.APB2TimFreq_Value=72000000
RCC.HCLKFreq_Value=72000000
RCC.PLLMUL=RCC_PLL_MUL9
RCC.PLLSourceVirtual=RCC_PLLSOURCE_HSE
RCC.SYSCLKFreq_VALUE=72000000
RCC.SYSCLKSource=RCC_SYSCLKSOURCE_PLLCLK
RCC.USBFreq_Value=72000000
SH.S_TIM1_CH1.0=TIM1_CH1,PWM Generation1 CH1
TIM1.Channel-PWM\ Generation1\ CH1=TIM_CHANNEL_1
TIM1.Period=1000
TIM1.Prescaler=71
VP_SYS_VS_ND.Mode=No_Debug
VP_TIM1_VS_ClockSourceINT.Mode=Internal
board=custom

// file: Core/Src/main.c
/* USER CODE BEGIN Header */
/**
  ******************************************************************************
  * @file           : main.c
  * @brief          : Main program body
  ******************************************************************************
  * @attention
  *
  * Copyright (c) 2026 STMicroelectronics.
  * All rights reserved.
  *
  * This software is licensed under terms that can be found in the LICENSE file
  * in the root directory of this software component.
  * If no LICENSE file comes with this software, it is provided AS-IS.
  *
  ******************************************************************************
  */
/* USER CODE END Header */
#include "main.h"

/* USER CODE BEGIN Includes */
#define BUZZER_TIM &htim1
#define BUZZER_CHANNEL TIM_CHANNEL_1

// Notalarin Frekanslari (Hz)
#define NOTE_B3  247  // Si (kalin, Do'nun altindaki Si)
#define NOTE_C4  262  // Do
#define NOTE_D4  294  // Re
#define NOTE_E4  330  // Mi
#define NOTE_F4  349  // Fa
#define NOTE_G4  392  // Sol
#define NOTE_A4  440  // La
#define NOTE_B4  494  // Si
#define NOTE_C5  523  // Do (ince)
#define NOTE_D5  587  // Re (ince)
#define NOTE_E5  659  // Mi (ince)
#define REST     0    // Sessizlik

// Notalar arasi kisa sessizlik (staccato). Bu sure nota suresinin ICINDEN
// dusulur, boylece tempo bozulmaz. Tum sureler bu degerden buyuk olmali.
#define NOTE_GAP_MS  40

// ---------------------------------------------------------------------------
// Yasasin Okulumuz (Daha dun annemizin) - Sure birimleri
// Tempoyu degistirmek icin sadece OKUL_Q degerini degistirmen yeterli.
// ---------------------------------------------------------------------------
#define OKUL_Q  500            // Dortluk nota (120 BPM)
#define OKUL_H  (OKUL_Q * 2)   // Ikilik nota

// ---------------------------------------------------------------------------
// Ari Viz Viz Viz - Sure birimleri
// Tempoyu degistirmek icin sadece ARI_E degerini degistirmen yeterli.
// ---------------------------------------------------------------------------
#define ARI_E  250             // Sekizlik nota
#define ARI_Q  (ARI_E * 2)     // Dortluk nota
#define ARI_H  (ARI_E * 4)     // Ikilik nota

// ===========================================================================
// YASASIN OKULUMUZ - Notalar
// (Fransiz melodisi "Ah! vous dirai-je, Maman" ile ayni; 8 dizelik tek kita)
// ===========================================================================
const uint16_t long_melody[] = {
  // Daha dun annemizin
  NOTE_C4, NOTE_C4, NOTE_G4, NOTE_G4, NOTE_A4, NOTE_A4, NOTE_G4,
  // kollarinda yasarken
  NOTE_F4, NOTE_F4, NOTE_E4, NOTE_E4, NOTE_D4, NOTE_D4, NOTE_C4,
  // Cicekli bahcemizin
  NOTE_C4, NOTE_C4, NOTE_G4, NOTE_G4, NOTE_A4, NOTE_A4, NOTE_G4,
  // yollarinda kosarken
  NOTE_F4, NOTE_F4, NOTE_E4, NOTE_E4, NOTE_D4, NOTE_D4, NOTE_C4,
  // Simdi okullu olduk
  NOTE_G4, NOTE_G4, NOTE_F4, NOTE_F4, NOTE_E4, NOTE_E4, NOTE_D4,
  // Siniflari doldurduk
  NOTE_G4, NOTE_G4, NOTE_F4, NOTE_F4, NOTE_E4, NOTE_E4, NOTE_D4,
  // Sevincliyiz hepimiz
  NOTE_C4, NOTE_C4, NOTE_G4, NOTE_G4, NOTE_A4, NOTE_A4, NOTE_G4,
  // Yasasin okulumuz
  NOTE_F4, NOTE_F4, NOTE_E4, NOTE_E4, NOTE_D4, NOTE_D4, NOTE_C4
};

// Her dize: 6 adet dortluk + son notada ikilik
#define OKUL_PHRASE  OKUL_Q, OKUL_Q, OKUL_Q, OKUL_Q, OKUL_Q, OKUL_Q, OKUL_H

// Nota Sureleri (ms)
const uint16_t long_durations[] = {
  OKUL_PHRASE,  // Daha dun annemizin
  OKUL_PHRASE,  // kollarinda yasarken
  OKUL_PHRASE,  // Cicekli bahcemizin
  OKUL_PHRASE,  // yollarinda kosarken
  OKUL_PHRASE,  // Simdi okullu olduk
  OKUL_PHRASE,  // Siniflari doldurduk
  OKUL_PHRASE,  // Sevincliyiz hepimiz
  OKUL_PHRASE   // Yasasin okulumuz
};

// ===========================================================================
// ARI VIZ VIZ VIZ - Notalar
// Not: Si (NOTE_B3) Do'nun ALTINDAKI Si'dir. Onceki kodda bir oktav yukaridaki
// Si/Re/Do/Mi (B4, D5, C5, E5) kullanilmisti, bu yuzden melodi bozuk duyuluyordu.
// ===========================================================================
const uint16_t ari_viz_melody[] = {
  // Yaz geldi cicekler acti
  NOTE_C4, NOTE_E4, NOTE_E4, NOTE_E4, NOTE_D4, NOTE_E4, NOTE_F4, NOTE_F4,
  // arilar hep dolasti
  NOTE_B3, NOTE_D4, NOTE_D4, NOTE_D4, NOTE_C4, NOTE_D4, NOTE_E4,
  // Yaz geldi cicekler acti
  NOTE_C4, NOTE_E4, NOTE_E4, NOTE_E4, NOTE_D4, NOTE_E4, NOTE_F4, NOTE_F4,
  // arilar hep dolasti (bitis, Do'ya cozulur)
  NOTE_B3, NOTE_D4, NOTE_D4, NOTE_D4, NOTE_C4, NOTE_B3, NOTE_C4,

  // Ari viz viz viz,
  NOTE_E4, NOTE_C4, NOTE_D4, NOTE_E4, NOTE_F4,
  // ari viz viz viz
  NOTE_D4, NOTE_B3, NOTE_C4, NOTE_D4, NOTE_E4,
  // Ari viz viz viz
  NOTE_E4, NOTE_C4, NOTE_D4, NOTE_E4, NOTE_F4,
  // diye dolasir
  NOTE_D4, NOTE_D4, NOTE_C4, NOTE_B3, NOTE_C4,

  // Ari viz viz viz,
  NOTE_E4, NOTE_C4, NOTE_D4, NOTE_E4, NOTE_F4,
  // ari viz viz viz
  NOTE_D4, NOTE_B3, NOTE_C4, NOTE_D4, NOTE_E4,
  // Ari viz viz viz
  NOTE_E4, NOTE_C4, NOTE_D4, NOTE_E4, NOTE_F4,
  // diye dolasir
  NOTE_D4, NOTE_D4, NOTE_C4, NOTE_B3, NOTE_C4
};

// Kalip 1: "Yaz geldi cicekler acti" -> 7 sekizlik + son notada dortluk (8 nota)
#define ARI_A_DUR  ARI_E, ARI_E, ARI_E, ARI_E, ARI_E, ARI_E, ARI_E, ARI_Q
// Kalip 2: "arilar hep dolasti" -> 6 sekizlik + son notada ikilik (7 nota)
#define ARI_B_DUR  ARI_E, ARI_E, ARI_E, ARI_E, ARI_E, ARI_E, ARI_H
// Kalip 3: "Ari viz viz viz" -> 4 sekizlik + son notada dortluk (5 nota)
#define ARI_C_DUR  ARI_E, ARI_E, ARI_E, ARI_E, ARI_Q
// Kalip 4: "diye dolasir" -> 4 sekizlik + son notada ikilik (5 nota)
#define ARI_D_DUR  ARI_E, ARI_E, ARI_E, ARI_E, ARI_H

// Nota Sureleri (ms)
const uint16_t ari_viz_durations[] = {
  ARI_A_DUR,                                    // Yaz geldi cicekler acti
  ARI_B_DUR,                                    // arilar hep dolasti
  ARI_A_DUR,                                    // Yaz geldi cicekler acti
  ARI_B_DUR,                                    // arilar hep dolasti (bitis)

  ARI_C_DUR, ARI_C_DUR, ARI_C_DUR, ARI_D_DUR,   // Ari viz viz viz ... diye dolasir
  ARI_C_DUR, ARI_C_DUR, ARI_C_DUR, ARI_D_DUR    // (tekrar)
};

// Nota dizisi ile sure dizisinin boyutu esit olmazsa derleme hatasi verir
_Static_assert(sizeof(long_melody) == sizeof(long_durations),
               "long_melody ve long_durations eleman sayisi esit olmali");
_Static_assert(sizeof(ari_viz_melody) == sizeof(ari_viz_durations),
               "ari_viz_melody ve ari_viz_durations eleman sayisi esit olmali");

/* USER CODE END Includes */

TIM_HandleTypeDef htim1;

void SystemClock_Config(void);
static void MX_GPIO_Init(void);
static void MX_TIM1_Init(void);
/* USER CODE BEGIN PFP */
// ===========================================================================
// Calma fonksiyonlari
// ===========================================================================
void Play_Tone(uint16_t frequency) {
  if (frequency == 0) {
    __HAL_TIM_SET_COMPARE(BUZZER_TIM, BUZZER_CHANNEL, 0); // Sessizlik
    return;
  }

  // Timer giris saatimiz 1 MHz oldugu icin Period = (1.000.000 / Frekans) - 1
  uint32_t period = (1000000 / frequency) - 1;

  __HAL_TIM_SET_AUTORELOAD(BUZZER_TIM, period);
  __HAL_TIM_SET_COMPARE(BUZZER_TIM, BUZZER_CHANNEL, (period + 1) / 2); // %50 Duty Cycle
}

static void Play_Melody(const uint16_t *notes, const uint16_t *durations, uint16_t total_notes) {
  HAL_TIM_PWM_Start(BUZZER_TIM, BUZZER_CHANNEL);

  for (uint16_t i = 0; i < total_notes; i++) {
    Play_Tone(notes[i]);
    HAL_Delay(durations[i] - NOTE_GAP_MS);

    // Notalarin birbirine yapismamasi icin kisa es (sure icinden dusuldu)
    Play_Tone(REST);
    HAL_Delay(NOTE_GAP_MS);
  }

  HAL_TIM_PWM_Stop(BUZZER_TIM, BUZZER_CHANNEL);
}

void Play_LongMelody(void) {
  Play_Melody(long_melody, long_durations,
              sizeof(long_melody) / sizeof(long_melody[0]));
}

void Play_AriVizVizVizMelody(void) {
  Play_Melody(ari_viz_melody, ari_viz_durations,
              sizeof(ari_viz_melody) / sizeof(ari_viz_melody[0]));
}
/* USER CODE END PFP */

int main(void)
{

  /* MCU Configuration--------------------------------------------------------*/

  /* Reset of all peripherals, Initializes the Flash interface and the Systick. */
  HAL_Init();

  /* Configure the system clock */
  SystemClock_Config();

  /* Initialize all configured peripherals */
  MX_GPIO_Init();
  MX_TIM1_Init();
  /* USER CODE BEGIN 2 */
  //Play_Melody();
  //Play_LongMelody();

  /* USER CODE END 2 */

  /* Infinite loop */
  while (1)
  {

    /* USER CODE BEGIN 3 */
	  Play_AriVizVizVizMelody();
	  HAL_Delay(2000);
	  Play_LongMelody();
	  HAL_Delay(2000);
  }
  /* USER CODE END 3 */
}

void SystemClock_Config(void)
{
  RCC_OscInitTypeDef RCC_OscInitStruct = {0};
  RCC_ClkInitTypeDef RCC_ClkInitStruct = {0};

  /** Initializes the RCC Oscillators according to the specified parameters
  * in the RCC_OscInitTypeDef structure.
  */
  RCC_OscInitStruct.OscillatorType = RCC_OSCILLATORTYPE_HSE;
  RCC_OscInitStruct.HSEState = RCC_HSE_ON;
  RCC_OscInitStruct.HSEPredivValue = RCC_HSE_PREDIV_DIV1;
  RCC_OscInitStruct.HSIState = RCC_HSI_ON;
  RCC_OscInitStruct.PLL.PLLState = RCC_PLL_ON;
  RCC_OscInitStruct.PLL.PLLSource = RCC_PLLSOURCE_HSE;
  RCC_OscInitStruct.PLL.PLLMUL = RCC_PLL_MUL9;
  if (HAL_RCC_OscConfig(&RCC_OscInitStruct) != HAL_OK)
  {
    Error_Handler();
  }

  /** Initializes the CPU, AHB and APB buses clocks
  */
  RCC_ClkInitStruct.ClockType = RCC_CLOCKTYPE_HCLK|RCC_CLOCKTYPE_SYSCLK
                              |RCC_CLOCKTYPE_PCLK1|RCC_CLOCKTYPE_PCLK2;
  RCC_ClkInitStruct.SYSCLKSource = RCC_SYSCLKSOURCE_PLLCLK;
  RCC_ClkInitStruct.AHBCLKDivider = RCC_SYSCLK_DIV1;
  RCC_ClkInitStruct.APB1CLKDivider = RCC_HCLK_DIV2;
  RCC_ClkInitStruct.APB2CLKDivider = RCC_HCLK_DIV1;

  if (HAL_RCC_ClockConfig(&RCC_ClkInitStruct, FLASH_LATENCY_2) != HAL_OK)
  {
    Error_Handler();
  }
}

static void MX_TIM1_Init(void)
{

  TIM_ClockConfigTypeDef sClockSourceConfig = {0};
  TIM_MasterConfigTypeDef sMasterConfig = {0};
  TIM_OC_InitTypeDef sConfigOC = {0};
  TIM_BreakDeadTimeConfigTypeDef sBreakDeadTimeConfig = {0};

  htim1.Instance = TIM1;
  htim1.Init.Prescaler = 71;
  htim1.Init.CounterMode = TIM_COUNTERMODE_UP;
  htim1.Init.Period = 1000;
  htim1.Init.ClockDivision = TIM_CLOCKDIVISION_DIV1;
  htim1.Init.RepetitionCounter = 0;
  htim1.Init.AutoReloadPreload = TIM_AUTORELOAD_PRELOAD_DISABLE;
  if (HAL_TIM_Base_Init(&htim1) != HAL_OK)
  {
    Error_Handler();
  }
  sClockSourceConfig.ClockSource = TIM_CLOCKSOURCE_INTERNAL;
  if (HAL_TIM_ConfigClockSource(&htim1, &sClockSourceConfig) != HAL_OK)
  {
    Error_Handler();
  }
  if (HAL_TIM_PWM_Init(&htim1) != HAL_OK)
  {
    Error_Handler();
  }
  sMasterConfig.MasterOutputTrigger = TIM_TRGO_RESET;
  sMasterConfig.MasterSlaveMode = TIM_MASTERSLAVEMODE_DISABLE;
  if (HAL_TIMEx_MasterConfigSynchronization(&htim1, &sMasterConfig) != HAL_OK)
  {
    Error_Handler();
  }
  sConfigOC.OCMode = TIM_OCMODE_PWM1;
  sConfigOC.Pulse = 0;
  sConfigOC.OCPolarity = TIM_OCPOLARITY_HIGH;
  sConfigOC.OCNPolarity = TIM_OCNPOLARITY_HIGH;
  sConfigOC.OCFastMode = TIM_OCFAST_DISABLE;
  sConfigOC.OCIdleState = TIM_OCIDLESTATE_RESET;
  sConfigOC.OCNIdleState = TIM_OCNIDLESTATE_RESET;
  if (HAL_TIM_PWM_ConfigChannel(&htim1, &sConfigOC, TIM_CHANNEL_1) != HAL_OK)
  {
    Error_Handler();
  }
  sBreakDeadTimeConfig.OffStateRunMode = TIM_OSSR_DISABLE;
  sBreakDeadTimeConfig.OffStateIDLEMode = TIM_OSSI_DISABLE;
  sBreakDeadTimeConfig.LockLevel = TIM_LOCKLEVEL_OFF;
  sBreakDeadTimeConfig.DeadTime = 0;
  sBreakDeadTimeConfig.BreakState = TIM_BREAK_DISABLE;
  sBreakDeadTimeConfig.BreakPolarity = TIM_BREAKPOLARITY_HIGH;
  sBreakDeadTimeConfig.AutomaticOutput = TIM_AUTOMATICOUTPUT_DISABLE;
  if (HAL_TIMEx_ConfigBreakDeadTime(&htim1, &sBreakDeadTimeConfig) != HAL_OK)
  {
    Error_Handler();
  }
  HAL_TIM_MspPostInit(&htim1);

}

static void MX_GPIO_Init(void)
{

  /* GPIO Ports Clock Enable */
  __HAL_RCC_GPIOD_CLK_ENABLE();
  __HAL_RCC_GPIOA_CLK_ENABLE();

}

void Error_Handler(void)
{
  __disable_irq();
  while (1)
  {
  }
}
